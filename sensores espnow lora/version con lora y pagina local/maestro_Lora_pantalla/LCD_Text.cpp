#include "LCD_Text.h"

#include <ctype.h>

namespace {

const uint8_t* glyphFor(char c)
{
  static const uint8_t blank[7] = {0, 0, 0, 0, 0, 0, 0};
  static const uint8_t dash[7] = {0, 0, 0, 0x1F, 0, 0, 0};
  static const uint8_t dot[7] = {0, 0, 0, 0, 0, 0x0C, 0x0C};
  static const uint8_t colon[7] = {0, 0x0C, 0x0C, 0, 0x0C, 0x0C, 0};
  static const uint8_t slash[7] = {0x01, 0x02, 0x04, 0x08, 0x10, 0, 0};
  static const uint8_t underscore[7] = {0, 0, 0, 0, 0, 0, 0x1F};
  static const uint8_t percent[7] = {0x19, 0x19, 0x02, 0x04, 0x08, 0x13, 0x13};

  static const uint8_t digits[10][7] = {
    {0x0E, 0x11, 0x13, 0x15, 0x19, 0x11, 0x0E},
    {0x04, 0x0C, 0x14, 0x04, 0x04, 0x04, 0x1F},
    {0x0E, 0x11, 0x01, 0x02, 0x04, 0x08, 0x1F},
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    {0x0E, 0x11, 0x11, 0x0F, 0x01, 0x02, 0x0C},
  };

  static const uint8_t letters[26][7] = {
    {0x0E, 0x11, 0x11, 0x1F, 0x11, 0x11, 0x11},
    {0x1E, 0x11, 0x11, 0x1E, 0x11, 0x11, 0x1E},
    {0x0E, 0x11, 0x10, 0x10, 0x10, 0x11, 0x0E},
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    {0x1F, 0x01, 0x02, 0x04, 0x08, 0x10, 0x1F},
  };

  if (c >= '0' && c <= '9') return digits[c - '0'];
  if (c >= 'A' && c <= 'Z') return letters[c - 'A'];

  switch (c) {
    case '-': return dash;
    case '.': return dot;
    case ':': return colon;
    case '/': return slash;
    case '_': return underscore;
    case '%': return percent;
    case ' ':
    default:
      return blank;
  }
}

}  // namespace

void LCD_DrawChar(uint16_t x, uint16_t y, char c, uint16_t color, uint8_t scale)
{
  if (scale == 0) {
    scale = 1;
  }

  const char normalized = static_cast<char>(toupper(static_cast<unsigned char>(c)));
  const uint8_t* glyph = glyphFor(normalized);

  for (uint8_t row = 0; row < 7; ++row) {
    const uint8_t bits = glyph[row];
    for (uint8_t col = 0; col < 5; ++col) {
      if (bits & (1U << (4 - col))) {
        LCD_FillRect(x + (col * scale), y + (row * scale), scale, scale, color);
      }
    }
  }
}

void LCD_DrawText(uint16_t x, uint16_t y, const String& text, uint16_t color, uint8_t scale)
{
  const uint16_t step = 6U * (scale == 0 ? 1U : scale);
  for (size_t i = 0; i < text.length(); ++i) {
    LCD_DrawChar(x + (i * step), y, text[i], color, scale);
  }
}

uint16_t LCD_TextWidth(const String& text, uint8_t scale)
{
  if (text.isEmpty()) {
    return 0;
  }

  if (scale == 0) {
    scale = 1;
  }

  return static_cast<uint16_t>((text.length() * 6U - 1U) * scale);
}

uint16_t LCD_TextHeight(uint8_t scale)
{
  if (scale == 0) {
    scale = 1;
  }

  return 7U * scale;
}
